## package/sysid101/Config.in
```kconfig
config BR2_PACKAGE_SYSID101
  bool "sysid101"
  depends on BR2_PACKAGE_GTKIOSTREAM
  help
    This is the sysid101 from flatmax.

    santos.baez.gabriel.elo@gmail.com
```
